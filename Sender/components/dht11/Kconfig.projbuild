## Sender/components/dht11/Kconfig.projbuild
```kconfig
menu "DHT11 Configuration"

	config GPIO_RANGE_MAX
		int
		default 33 if IDF_TARGET_ESP32
		default 46 if IDF_TARGET_ESP32S2
		default 19 if IDF_TARGET_ESP32C3
		default 48 if IDF_TARGET_ESP32S3

	config DATA_GPIO
		int "DATA GPIO"
		range 0 GPIO_RANGE_MAX
		default 4 if IDF_TARGET_ESP32
		default 34 if IDF_TARGET_ESP32S2
		default 9  if IDF_TARGET_ESP32C3
		help
			Pin Number where the NCS pin of the LoRa module is connected to.

endmenu
```
